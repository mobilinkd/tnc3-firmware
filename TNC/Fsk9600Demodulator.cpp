// Copyright 2020 Rob Riggs <rob@mobilinkd.com>
// All rights reserved.

#include "Fsk9600Demodulator.hpp"
#include "Goertzel.h"
#include "AudioInput.hpp"
#include "GPIO.hpp"
#include "Log.h"
#include "power.h"

namespace mobilinkd { namespace tnc {

hdlc::IoFrame* Fsk9600Demodulator::operator()(const q15_t* samples)
{
    hdlc::IoFrame* result = nullptr;

    auto filtered = demod_filter.filter(const_cast<q15_t* >(samples));

    for (size_t i = 0; i != ADC_BLOCK_SIZE; ++i)
    {
        auto sample = filtered[i];

        bool bit = sample >= 0;
        auto pll = pll_(bit);

        if (pll.sample)
        {
            locked_ = pll.locked;

            // We will only ever get one frame because there are
            // not enough bits in a block for more than one.
            if (result) {
                auto tmp = hdlc_decoder_(nrzi_.decode(lfsr_(bit)), locked_);
                if (tmp) hdlc::release(tmp);
            } else {
                result = hdlc_decoder_(nrzi_.decode(lfsr_(bit)), locked_);
#ifdef KISS_LOGGING
                if (result) {
                    INFO("samples = %ld, mean = %d, dev = %d",
                        snr_.samples, int(snr_.mean), int(snr_.stdev()));
                    INFO("SNR = %dmB", int(snr_.SNR() * 100.0f));
                    snr_.reset();
                }
#endif
            }

#ifdef KISS_LOGGING
            if (hdlc_decoder_.active())
            {
                if (!decoding_)
                {
                    snr_.reset();
                    decoding_ = true;
                }
                snr_.capture(float(abs(sample)));
            } else {
                decoding_ = false;
            }
#endif
        }

    }
    return result;
}

/*
 * Return twist as a the difference in dB between mark and space.  The
 * expected values are about 0dB for discriminator output and about 5.5dB
 * for de-emphasized audio.
 */
float Fsk9600Demodulator::readTwist()
{
    TNC_DEBUG("enter Fsk9600Demodulator::readTwist");

    float g120 = 0.0f;
    float g4800 = 0.0f;

    GoertzelFilter<ADC_BLOCK_SIZE, SAMPLE_RATE> gf120(120.0, 0);
    GoertzelFilter<ADC_BLOCK_SIZE, SAMPLE_RATE> gf4800(4800.0, 0);

    const uint32_t AVG_SAMPLES = 160;

    startADC(416, ADC_BLOCK_SIZE);

    for (uint32_t i = 0; i != AVG_SAMPLES; ++i)
    {
        uint32_t count = 0;
        while (count < ADC_BLOCK_SIZE)
        {
            osEvent evt = osMessageGet(adcInputQueueHandle, osWaitForever);
            if (evt.status != osEventMessage)
                continue;

            auto block = (audio::adc_pool_type::chunk_type*) evt.value.p;
            uint16_t* data = (uint16_t*) block->buffer;
            gf120(data, ADC_BLOCK_SIZE);
            gf4800(data, ADC_BLOCK_SIZE);

            audio::adcPool.deallocate(block);

            count += ADC_BLOCK_SIZE;
        }

        g120 += (gf120 / count);
        g4800 += (gf4800 / count);

        gf120.reset();
        gf4800.reset();
    }

    IDemodulator::stopADC();

    g120 = 10.0f * log10f(g120 / AVG_SAMPLES);
    g4800 = 10.0f * log10f(g4800 / AVG_SAMPLES);

    auto result = g120 - g4800;

    INFO("9600 Twist = %d / 100 (%d - %d)", int(result * 100), int(g120 * 100),
        int(g4800 * 100));

    TNC_DEBUG("exit Fsk9600Demodulator::readTwist");
    return result;
}

uint32_t Fsk9600Demodulator::readBatteryLevel()
{
#ifdef TNC_HAS_BAT
    return read_battery_level();
#else
    return 0;
#endif
}

const Fsk9600Demodulator::bpf_bank_type Fsk9600Demodulator::bpf_bank = {{
    // -3dB, gain = 0.251188643150958, actual = -1.67dB
    {{
            0,     0,     0,     0,     0,     0,     0,     0,     0,     0,     0,     0,
            1,     1,     2,     2,     3,     4,     4,     5,     6,     7,     8,     9,
           10,    12,    14,    16,    19,    23,    28,    34,    41,    50,    59,    69,
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            0,     0,     0,     0,     0,     0,     0,     0,
    }},
    // -2dB, gain = 0.3981071705534972, actual = -1.22dB
    {{
            0,     0,     0,     0,     0,     0,     0,     0,     0,     0,     0,     0,
            1,     1,     2,     2,     3,     3,     4,     4,     4,     4,     4,     4,
            4,     5,     5,     7,     9,    13,    18,    24,    33,    43,    54,    67,
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            0,     0,     0,     0,     0,     0,     0,     0,
    }},
    // -1dB, gain = 0.6309573444801932, actual = -0.69dB
    {{
            0,     0,     0,     0,     0,     0,     0,     0,     0,     0,     0,     0,
            1,     1,     2,     2,     3,     3,     3,     2,     1,     0,     0,    -2,
           -4,    -6,    -7,    -7,    -5,    -3,     2,     9,    19,    32,    47,    64,
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            0,     0,     0,     0,     0,     0,     0,     0,
    }},
    // 0dB, gain = 1.0, actual = -0.03dB
    {{
            0,     0,     0,     0,     0,     0,     0,     0,     0,     0,     0,     1,
            1,     2,     2,     2,     2,     2,     1,     0,    -2,    -6,   -10,   -14,
          -19,   -23,   -27,   -30,   -30,   -29,   -24,   -15,    -2,    14,    35,    60,
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            0,     0,     0,     0,     0,     0,     0,     0,
    }},
    // 1dB, gain = 1.5848931924611136, actual = 0.70dB
    {{
            0,     0,     0,     0,     0,     0,     0,     0,     0,     0,     0,     1,
            2,     2,     2,     3,     2,     1,    -1,    -4,   -10,   -16,   -24,   -33,
          -42,   -51,   -60,   -66,   -70,   -70,   -65,   -54,   -37,   -13,    17,    53,
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            0,     0,     0,     0,     0,     0,     0,     0,
    }},
    // 2dB, gain = 2.51188643150958, actual = 1.42dB
    {{
            0,     0,     0,     0,     0,     0,     0,     0,     0,     0,     1,     1,
            2,     3,     3,     3,     1,     0,    -5,   -12,   -21,   -33,   -47,   -62,
          -79,   -96,  -112,  -125,  -133,  -135,  -130,  -116,   -91,   -57,   -11,    43,
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            0,     0,     0,     0,     0,     0,     0,     0,
    }},
    // 3dB, gain = 3.9810717055349722, actual = 2.07dB
    {{
            0,     0,     0,     0,     0,     0,     0,     0,     0,     0,     1,     2,
            3,     4,     4,     3,     0,    -4,   -12,   -24,   -39,   -59,   -83,  -109,
         -138,  -167,  -194,  -217,  -233,  -239,  -234,  -214,  -178,  -126,   -58,    26,
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            0,     0,     0,     0,     0,     0,     0,     0,
    }},
    // 4dB, gain = 6.309573444801933, actual = 2.59dB
    {{
            0,     0,     0,     0,     0,     0,     0,     0,     0,     0,     2,     3,
            5,     6,     6,     4,     0,    -9,   -23,   -42,   -68,  -101,  -140,  -184,
         -231,  -279,  -324,  -363,  -391,  -404,  -398,  -369,  -316,  -237,  -131,     0,
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            0,     0,     0,     0,     0,     0,     0,     0,
    }},
    // 5dB, gain = 10.0, actual = 2.99dB
    {{
            1,     0,     0,     0,     0,     0,     0,     0,     0,     1,     3,     5,
            7,     9,     8,     5,    -3,   -17,   -40,   -72,  -114,  -168,  -231,  -302,
         -378,  -456,  -530,  -594,  -641,  -664,  -658,  -616,  -535,  -411,  -247,   -43,
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            0,     0,     0,     0,     0,     0,     0,     1,
    }},
    // 6dB, gain = 15.848931924611133, actual = 3.28dB
    {{
            1,     1,     0,     0,     0,    -1,    -1,    -1,     0,     2,     4,     8,
           11,    13,    12,     6,    -7,   -31,   -67,  -119,  -187,  -273,  -374,  -489,
         -612,  -738,  -857,  -960, -1037, -1077, -1070, -1007,  -881,  -689,  -431,  -111,
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           -1,    -1,    -1,     0,     0,     0,     1,     1,
    }},
    // 7dB, gain = 25.118864315095795, actual = 3.48dB
    {{
            2,     2,     1,     0,    -1,    -2,    -2,    -1,     0,     3,     7,    12,
           17,    20,    18,     8,   -13,   -52,  -110,  -193,  -303,  -440,  -602,  -785,
         -983, -1183, -1375, -1541, -1666, -1732, -1723, -1626, -1429, -1128,  -722,  -218,
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           -1,    -2,    -2,    -1,     0,     1,     2,     2,
    }},
    // 8dB, gain = 39.810717055349734, actual = 3.61dB
    {{
            4,     3,     1,     0,    -1,    -3,    -3,    -3,     0,     4,    11,    20,
           27,    32,    28,    12,   -23,   -85,  -179,  -311,  -486,  -704,  -963, -1255,
        -1570, -1890, -2196, -2462, -2662, -2770, -2759, -2607, -2299, -1824, -1184,  -388,
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           -3,    -3,    -3,    -1,     0,     1,     3,     4,
    }},
    // 9dB, gain = 63.09573444801933, actual = 3.69dB
    {{
            6,     4,     2,     0,    -3,    -5,    -6,    -4,     0,     7,    18,    31,
           43,    49,    44,    17,   -39,  -137,  -287,  -499,  -776, -1123, -1535, -2000,
        -2500, -3010, -3497, -3921, -4241, -4415, -4400, -4163, -3677, -2927, -1916,  -658,
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           -4,    -6,    -5,    -3,     0,     2,     4,     6,
    }}
}};

}} // mobilinkd::tnc

